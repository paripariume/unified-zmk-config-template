#include "sosho_L.dtsi"

&spi0 { status = "okay"; };
&glidepoint {
    status = "okay";
    invert-x;
    primary-tap-enable;
};
&glidepoint_split {
    status = "okay";
    device = <&glidepoint>;
};
